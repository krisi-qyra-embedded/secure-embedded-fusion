## esp32/ESP32_AES_GCM_UART_STM32_HTTPS_MQTT/main/Kconfig.projbuild
```kconfig
menu "CCS811 configuration"

    choice CCS811_I2C_ADDRESS
        prompt "Select CCS811 I2C address"
        default CCS811_I2C_ADDRESS_0
        help
            Select CCS811 I2C address.

        config CCS811_I2C_ADDRESS_0
            bool "CCS811_I2C_ADDRESS_1 (0x5A)"

        config CCS811_I2C_ADDRESS_1
            bool "CCS811_I2C_ADDRESS_2 (0x5B)"
    endchoice

    config CCS811_I2C_MASTER_SCL
        int "CCS811 SCL GPIO Number"
        default 5 if IDF_TARGET_ESP8266
        default 6 if IDF_TARGET_ESP32C3
        default 19 if IDF_TARGET_ESP32 || IDF_TARGET_ESP32S2 || IDF_TARGET_ESP32S3
        help
            GPIO number for CCS811 I2C master clock line.

    config CCS811_I2C_MASTER_SDA
        int "CCS811 SDA GPIO Number"
        default 4 if IDF_TARGET_ESP8266
        default 5 if IDF_TARGET_ESP32C3
        default 18 if IDF_TARGET_ESP32 || IDF_TARGET_ESP32S2 || IDF_TARGET_ESP32S3
        help
            GPIO number for CCS811 I2C master data line.

endmenu
```
